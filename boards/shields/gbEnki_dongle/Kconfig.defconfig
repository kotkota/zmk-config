## boards/shields/gbEnki_dongle/Kconfig.defconfig
```kconfig
# Copyright (c) 2020 The ZMK Contributors
# SPDX-License-Identifier: MIT

if SHIELD_GBENKI_DONGLE

config ZMK_KEYBOARD_NAME
	default "gbEnki Dongle"

config ZMK_SPLIT_BLE_ROLE_CENTRAL
	default y

config ZMK_USB
	default y

endif

if SHIELD_GBENKI_DONGLE_LEFT || SHIELD_GBENKI_DONGLE_RIGHT || SHIELD_GBENKI_DONGLE

config ZMK_SPLIT
	default y

config ZMK_BLE
	default y

endif
```

## boards/shields/gbEnki_dongle/Kconfig.shield
```kconfig
# Copyright (c) 2020 The ZMK Contributors
# SPDX-License-Identifier: MIT

config SHIELD_GBENKI_DONGLE_LEFT
	def_bool $(shields_list_contains,gbEnki_dongle_left)

config SHIELD_GBENKI_DONGLE_RIGHT
	def_bool $(shields_list_contains,gbEnki_dongle_right)

config SHIELD_GBENKI_DONGLE
	def_bool $(shields_list_contains,gbEnki_dongle)
```

## config/west.yml
```yaml
manifest:
  remotes:
    - name: zmkfirmware
      url-base: https://github.com/zmkfirmware
    - name: garrettfaucher
      url-base: https://github.com/garrettfaucher
    - name: urob
      url-base: https://github.com/urob
    - name: kotkota
      url-base: https://github.com/kotkota
  projects:
    - name: zmk
      remote: zmkfirmware
      revision: v0.3
      import: app/west.yml
    # - name: zmk-dongle-display-091-oled
    #   remote: garrettfaucher
    #   revision: main
    - name: zmk-driver-pmw3360
      remote: garrettfaucher
      revision: invert-x-y
    - name: zmk-leader-key
      remote: urob
      revision: v0.3
    - name: zmk-adaptive-key
      remote: urob
      revision: v0.3
    - name: zmk-auto-layer
      remote: urob
      revision: v0.3
    - name: zmk-dongle-display-view
      remote: kotkota
      revision: main
  self:
    path: config
```
